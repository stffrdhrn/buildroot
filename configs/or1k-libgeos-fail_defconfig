## configs/or1k-libgeos-fail_defconfig
```kconfig
BR2_or1k=y
BR2_TOOLCHAIN_BUILDROOT_WCHAR=y
BR2_BINUTILS_VERSION_2_36_X=y
BR2_GCC_VERSION_10_X=y
BR2_TOOLCHAIN_BUILDROOT_CXX=y
BR2_PACKAGE_OPENAL=y
BR2_PACKAGE_LIBTHEORA=y
BR2_PACKAGE_LIBGEOS=y
```
